## cpp/wifi/Kconfig
```kconfig
menu "Amikodev Wi-Fi"

config AMIKODEV_WIFI_AP_ENABLED
    bool "AP enabled"
    default true
    help 
        AP enabled

config AMIKODEV_WIFI_AP_SSID
    string "AP SSID"
    default "Amikodev_ESP32-AP"
    depends on AMIKODEV_WIFI_AP_ENABLED
    help
        AP SSID

config AMIKODEV_WIFI_AP_PSSWD
    string "AP PSSWD"
    default "12345678"
    depends on AMIKODEV_WIFI_AP_ENABLED
    help
        AP PSSWD

config AMIKODEV_WIFI_AP_HIDDEN
    bool "AP HIDDEN"
    default false
    depends on AMIKODEV_WIFI_AP_ENABLED
    help
        AP HIDDEN



config AMIKODEV_WIFI_STA_ENABLED
    bool "STA enabled"
    default false
    help 
        STA enabled

config AMIKODEV_WIFI_STA_SSID
    string "STA SSID"
    depends on AMIKODEV_WIFI_STA_ENABLED
    help
        STA SSID

config AMIKODEV_WIFI_STA_PSSWD
    string "STA PSSWD"
    depends on AMIKODEV_WIFI_STA_ENABLED
    help
        STA PSSWD

config AMIKODEV_WIFI_USE_WEBSOCKET
    bool "Use Websocket"
    default true
    help
        Use Websocket connections

config AMIKODEV_WIFI_INCLUDE_EMBED_WEB_FILES
    bool "Include embed web files"
    default false
    help
        Include embed web files

config AMIKODEV_WIFI_SD_CARD
    bool "SD card"
    default false
    help
        SD card enabled

config AMIKODEV_WIFI_SPIFFS
    bool "Spiffs"
    default false
    help
        Spiffs enabled

config AMIKODEV_WIFI_NVS_FLASH
    bool "NVS flash"
    default false
    help
        NVS flash enable

endmenu
```
